//-----------------------------------------------------------------
// 程序描述:
//     IIC驱动程序
// 作    者: 凌智电子
// 开始日期: 2014-01-28
// 完成日期: 2014-01-28
// 修改日期: 2014-02-16
// 当前版本: V1.0.1
// 历史版本:
//  - V1.0: (2014-02-07)IIC配置
// - V1.0.1:(2014-02-16)头文件中不包含其他头文件
// 调试工具: 凌智STM32核心开发板、LZE_ST_LINK2
// 说    明:
//
//-----------------------------------------------------------------

//-----------------------------------------------------------------
// 头文件包含
//-----------------------------------------------------------------
#include <stm32f10x.h>
#include "I2C.h"
#include "delay.h"

//-----------------------------------------------------------------
// void IIC_Init(void)
//-----------------------------------------------------------------
//
// 函数功能: IIC初始化
// 入口参数: 无
// 返 回 值: 无
// 全局变量: 无
// 调用模块: RCC_APB2PeriphClockCmd();GPIO_Init();
// 注意事项: 无
//
//-----------------------------------------------------------------
void IIC_Init(void)
{					     
	GPIO_InitTypeDef GPIO_InitStructure;
	RCC_APB2PeriphClockCmd(	RCC_APB2Periph_GPIOB, ENABLE );
	   
	GPIO_InitStructure.GPIO_Pin = GPIO_Pin_6|GPIO_Pin_7;
	GPIO_InitStructure.GPIO_Mode = GPIO_Mode_Out_PP ;
	GPIO_InitStructure.GPIO_Speed = GPIO_Speed_10MHz;
	GPIO_Init(GPIOB, &GPIO_InitStructure);
	GPIO_SetBits(GPIOB,GPIO_Pin_6|GPIO_Pin_7);
}

//-----------------------------------------------------------------
// void IIC_Init(void)
//-----------------------------------------------------------------
//
// 函数功能: 产生IIC起始信号
// 入口参数: 无
// 返 回 值: 无
// 全局变量: 无
// 调用模块: 无
// 注意事项: 无
//
//-----------------------------------------------------------------
void IIC_Start(void)
{
	SDA_OUT();
	IIC_SDA=1;	  	  
	IIC_SCL=1;
	Delay_1us(4);
 	IIC_SDA=0;
	Delay_1us(4);
	IIC_SCL=0;
}	  

//-----------------------------------------------------------------
// void IIC_Init(void)
//-----------------------------------------------------------------
//
// 函数功能: 产生IIC停止信号
// 入口参数: 无
// 返 回 值: 无
// 全局变量: 无
// 调用模块: 无
// 注意事项: 无
//
//-----------------------------------------------------------------
void IIC_Stop(void)
{
	SDA_OUT();
	IIC_SCL=0;
	IIC_SDA=0;
 	Delay_1us(4);
	IIC_SCL=1; 
	IIC_SDA=1;
	Delay_1us(4);							   	
}

//-----------------------------------------------------------------
// void IIC_Init(void)
//-----------------------------------------------------------------
//
// 函数功能: 等待应答信号到来
// 入口参数: 无
// 返 回 值: 1: 接收应答失败
//					 0: 接收应答成功
// 全局变量: 无
// 调用模块: 无
// 注意事项: 无
//
//-----------------------------------------------------------------
uint8_t IIC_Wait_Ack(void)
{
	uint8_t ucErrTime=0;
	SDA_IN();
	IIC_SDA=1;
	Delay_1us(1);	   
	IIC_SCL=1;
	Delay_1us(1);	 
	while(READ_SDA)
	{
		ucErrTime++;
		if(ucErrTime>250)
		{
			IIC_Stop();
			return 1;
		}
	}
	IIC_SCL=0;   
	return 0;  
} 

//-----------------------------------------------------------------
// void IIC_Init(void)
//-----------------------------------------------------------------
//
// 函数功能: 产生ACK应答
// 入口参数: 无
// 返 回 值: 无
// 全局变量: 无
// 调用模块: 无
// 注意事项: 无
//
//-----------------------------------------------------------------
void IIC_Ack(void)
{
	IIC_SCL=0;
	SDA_OUT();
	IIC_SDA=0;
	Delay_1us(2);
	IIC_SCL=1;
	Delay_1us(2);
	IIC_SCL=0;
}

//-----------------------------------------------------------------
// void IIC_Init(void)
//-----------------------------------------------------------------
//
// 函数功能: 不产生ACK应答		
// 入口参数: 无
// 返 回 值: 无
// 全局变量: 无
// 调用模块: 无
// 注意事项: 无
//
//-----------------------------------------------------------------
void IIC_NAck(void)
{
	IIC_SCL=0;
	SDA_OUT();
	IIC_SDA=1;
	Delay_1us(2);
	IIC_SCL=1;
	Delay_1us(2);
	IIC_SCL=0;
}					 				     

//-----------------------------------------------------------------
// void IIC_Init(void)
//-----------------------------------------------------------------
//
// 函数功能: IIC发送一个字节		
// 入口参数: 无
// 返 回 值: 从机有无应答，1：有应答，0：无应答	
// 全局变量: 无
// 调用模块: 无
// 注意事项: 无
//
//-----------------------------------------------------------------
void IIC_Send_Byte(uint8_t txd)
{                        
	uint8_t t;   
	SDA_OUT(); 	    
	IIC_SCL=0;
	for(t=0;t<8;t++)
	{              
		IIC_SDA=(txd&0x80)>>7;
		txd<<=1; 	  
		Delay_1us(2);
		IIC_SCL=1;
		Delay_1us(2); 
		IIC_SCL=0;	
		Delay_1us(2);
	}	 
} 	    

//-----------------------------------------------------------------
// void IIC_Init(void)
//-----------------------------------------------------------------
//
// 函数功能: IIC读取一个字节		
// 入口参数: ack：ack=1时，发送ACK，ack=0，发送nACK  
// 返 回 值: IIC读取的字节
// 全局变量: 无
// 调用模块: 无
// 注意事项: 无
//
//-----------------------------------------------------------------
uint8_t IIC_Read_Byte(unsigned char ack)
{
	unsigned char i,receive=0;
	SDA_IN();
  for(i=0;i<8;i++ )
	{
		IIC_SCL=0; 
    Delay_1us(2);
		IIC_SCL=1;
    receive<<=1;
    if(READ_SDA)
			receive++;   
		Delay_1us(1); 
  }					 
	if (!ack)
			IIC_NAck();
	else
			IIC_Ack();
	return receive;
}

//-----------------------------------------------------------------
// End Of File
//-----------------------------------------------------------------
